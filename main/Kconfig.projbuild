## main/Kconfig.projbuild
```kconfig
menu "Example Configuration"

    choice
        bool "Mesh Topology"
        default MESH_TOPO_TREE
        help
            Mesh Network Topology.

        config MESH_TOPO_TREE
            bool "MESH_TOPO_TREE"
        config MESH_TOPO_CHAIN
            bool "MESH_TOPO_CHAIN"
    endchoice

    config MESH_TOPOLOGY
        int
        default 0 if MESH_TOPO_TREE
        default 1 if MESH_TOPO_CHAIN
        help
            Mesh Network Topology.

    config MESH_ENABLE_PS
        bool "Enable mesh PS (power save) function"
        default n
        help
            Enable/Disable Power Save function.

    choice
        bool "Mesh PS device duty cycle type"
        depends on MESH_ENABLE_PS
        default MESH_PS_DEV_DUTY_TYPE_REQUEST
        help
            Mesh PS device duty cycle type.

        config MESH_PS_DEV_DUTY_TYPE_REQUEST
            bool "MESH_PS_DEV_DUTY_TYPE_REQUEST"
        config MESH_PS_DEV_DUTY_TYPE_DEMAND
            bool "MESH_PS_DEV_DUTY_TYPE_DEMAND"
    endchoice

    config MESH_PS_DEV_DUTY_TYPE
        int
        depends on MESH_ENABLE_PS
        default 1 if MESH_PS_DEV_DUTY_TYPE_REQUEST
        default 4 if MESH_PS_DEV_DUTY_TYPE_DEMAND
        help
            Mesh PS device duty cycle type.

    config MESH_PS_DEV_DUTY
        int "Mesh PS device duty cycle"
        depends on MESH_ENABLE_PS
        range 1 100
        default 10
        help
            Mesh PS device duty cycle.

    config MESH_PS_NWK_DUTY
        int "Mesh PS network duty cycle"
        depends on MESH_ENABLE_PS
        range 1 100
        default 10
        help
            Mesh PS network duty cycle.

    config MESH_PS_NWK_DUTY_DURATION
        int "Mesh PS network duty cycle duration (unit: minutes)"
        depends on MESH_ENABLE_PS
        range -1 100
        default -1
        help
            Mesh PS network duty cycle duration.

    choice
        bool "Mesh PS network duty cycle rule"
        depends on MESH_ENABLE_PS
        default MESH_PS_NETWORK_DUTY_APPLIED_ENTIRE
        help
            Mesh PS network duty cycle rule.

        config MESH_PS_NETWORK_DUTY_APPLIED_ENTIRE
            bool "MESH_PS_NETWORK_DUTY_APPLIED_ENTIRE"
        config MESH_PS_NETWORK_DUTY_APPLIED_UPLINK
            bool "MESH_PS_NETWORK_DUTY_APPLIED_UPLINK"
    endchoice

    config MESH_PS_NWK_DUTY_RULE
        int
        depends on MESH_ENABLE_PS
        default 0 if MESH_PS_NETWORK_DUTY_APPLIED_ENTIRE
        default 1 if MESH_PS_NETWORK_DUTY_APPLIED_UPLINK
        help
            Mesh PS network duty cycle rule.

    config MESH_MAX_LAYER
        int "Mesh Max Layer"
        range 1 25 if MESH_TOPO_TREE
        range 1 1000 if MESH_TOPO_CHAIN
        default 6
        help
            Max layer allowed in mesh network.

    config CHOINKA_DIRECT_ROOT_ONLY
        bool "Emergency: force choinka to attach only near root"
        default n
        help
            Limits choinka to layer 2 as a temporary recovery/stabilization
            mode. Keep disabled for V2 tunnel and chained mesh testing.

    config CHOINKA_MESH_RELAY_ELIGIBLE
        bool "Advertise ESP-MESH relay eligibility"
        default y
        help
            Advertises that this firmware permits ESP-MESH child routing.
            It does not claim a separate application hop-by-hop transport.

    config CHOINKA_DIRECT_MAX_LAYER
        int "Emergency direct-root max layer"
        depends on CHOINKA_DIRECT_ROOT_ONLY
        range 2 25
        default 2
        help
            Max layer used when CHOINKA_DIRECT_ROOT_ONLY is enabled.

    config CHOINKA_V2_LOG_TUNNEL_ENABLE
        bool "Send log lines through V2 tunnel"
        default y
        help
            Send remote log lines through the typed reliable V2 channel.
            Disable only for an explicit compatibility diagnostic build.

    config CHOINKA_PSRAM_EXPECTED_BYTES
        int "Expected PSRAM capacity in bytes"
        range 0 33554432
        default 0
        help
            Optional board note for diagnostics when runtime PSRAM is inactive
            or not detected. If PSRAM is detected and initialized, telemetry
            uses the measured PSRAM heap size instead.

    menu "Choinka pump controller"

        config CHOINKA_PUMP_ACTIVE_HIGH
            bool "Pump input is active high"
            default y
            help
                GPIO26 HIGH enables the current pump driver. Disable only for
                hardware with an active-low input.

        config CHOINKA_PUMP_BOOT_PULSE_ENABLE
            bool "Enable cold-power-on pump pulse"
            default y
            help
                Run the compatibility pump pulse only after ESP_RST_POWERON.
                OTA, software, watchdog, panic and brownout resets skip it.

        config CHOINKA_PUMP_BOOT_PULSE_MS
            int "Cold-power-on pulse duration (ms)"
            depends on CHOINKA_PUMP_BOOT_PULSE_ENABLE
            range 10 1000
            default 200

        config CHOINKA_PUMP_CHECK_PERIOD_MS
            int "Water-level check period (ms)"
            range 100 10000
            default 1000

        config CHOINKA_PUMP_MAX_RUN_MS
            int "Maximum pump run time (ms)"
            range 100 30000
            default 3000

        config CHOINKA_PUMP_MIN_PAUSE_MS
            int "Minimum pause between runs (ms)"
            range 1000 3600000
            default 60000

        config CHOINKA_LEVEL_DRY_THRESHOLD_MV
            int "Dry electrode threshold (mV)"
            range 0 3300
            default 1100

        config CHOINKA_LEVEL_WET_THRESHOLD_MV
            int "Wet electrode threshold (mV)"
            range 0 3300
            default 1900

        config CHOINKA_LEVEL_DRY_CONFIRM_CYCLES
            int "Consecutive dry samples before a run"
            range 1 20
            default 3

        config CHOINKA_LEVEL_WET_CONFIRM_CYCLES
            int "Consecutive wet samples before stopping"
            range 1 20
            default 2

    endmenu

    config MESH_CHANNEL
        int "channel"
        range 0 14
        default 0
        help
            mesh network channel.

    config MESH_ROUTER_SSID
        string "Router SSID"
        default "ROUTER_SSID"
        help
            Router SSID.

    config MESH_ROUTER_PASSWD
        string "Router password"
        default "ROUTER_PASSWD"
        help
            Router password.

    choice
        bool "Mesh AP Authentication Mode"
        default WIFI_AUTH_WPA2_PSK
        help
            Authentication mode.

        config WIFI_AUTH_OPEN
            bool "WIFI_AUTH_OPEN"
        config WIFI_AUTH_WPA_PSK
            bool "WIFI_AUTH_WPA_PSK"
        config WIFI_AUTH_WPA2_PSK
            bool "WIFI_AUTH_WPA2_PSK"
        config WIFI_AUTH_WPA_WPA2_PSK
            bool "WIFI_AUTH_WPA_WPA2_PSK"
    endchoice

    config MESH_AP_AUTHMODE
        int
        default 0 if WIFI_AUTH_OPEN
        default 2 if WIFI_AUTH_WPA_PSK
        default 3 if WIFI_AUTH_WPA2_PSK
        default 4 if WIFI_AUTH_WPA_WPA2_PSK
        help
            Mesh AP authentication mode.

    config MESH_AP_PASSWD
        string "Mesh AP Password"
        default "MAP_PASSWD"
        help
            Mesh AP password.

    config MESH_AP_CONNECTIONS
        int "Mesh AP Connections"
        range 1 10
        default 6
        help
            The number of mesh stations allowed to connect in.

    config MESH_NON_MESH_AP_CONNECTIONS
        int "Mesh Non Mesh AP Connections"
        range 0 9
        default 0
        help
            The number of non-mesh stations allowed to connect in.

    config MESH_ROUTE_TABLE_SIZE
        int "Mesh Routing Table Size"
        range 1 300
        default 50
        help
            The number of devices over the network(max: 300).
endmenu
```

## sdkconfig.defaults
```kconfig
CONFIG_COMPILER_OPTIMIZATION_SIZE=y
# CONFIG_MESH_ENABLE_PS is not set
CONFIG_CHOINKA_V2_LOG_TUNNEL_ENABLE=y
# CONFIG_KEEMASH_V2_COMPAT_TUNNEL_ENABLE is not set
CONFIG_CHOINKA_MESH_RELAY_ELIGIBLE=y
CONFIG_BOOTLOADER_APP_ROLLBACK_ENABLE=y
CONFIG_CHOINKA_PSRAM_EXPECTED_BYTES=0
CONFIG_CHOINKA_PUMP_ACTIVE_HIGH=y
CONFIG_CHOINKA_PUMP_BOOT_PULSE_ENABLE=y
CONFIG_CHOINKA_PUMP_BOOT_PULSE_MS=200
CONFIG_CHOINKA_PUMP_CHECK_PERIOD_MS=1000
CONFIG_CHOINKA_PUMP_MAX_RUN_MS=3000
CONFIG_CHOINKA_PUMP_MIN_PAUSE_MS=60000
CONFIG_CHOINKA_LEVEL_DRY_THRESHOLD_MV=1100
CONFIG_CHOINKA_LEVEL_WET_THRESHOLD_MV=1900
CONFIG_CHOINKA_LEVEL_DRY_CONFIRM_CYCLES=3
CONFIG_CHOINKA_LEVEL_WET_CONFIRM_CYCLES=2
CONFIG_SPIRAM=y
CONFIG_SPIRAM_TYPE_AUTO=y
CONFIG_SPIRAM_SPEED_40M=y
CONFIG_SPIRAM_IGNORE_NOTFOUND=y
CONFIG_SPIRAM_USE_MALLOC=y
CONFIG_SPIRAM_MALLOC_ALWAYSINTERNAL=16384
CONFIG_SPIRAM_MALLOC_RESERVE_INTERNAL=32768
CONFIG_FREERTOS_USE_TRACE_FACILITY=y
CONFIG_FREERTOS_USE_STATS_FORMATTING_FUNCTIONS=y
CONFIG_FREERTOS_GENERATE_RUN_TIME_STATS=y
CONFIG_FREERTOS_RUN_TIME_STATS_USING_ESP_TIMER=y
CONFIG_ESPTOOLPY_FLASHSIZE_4MB=y
CONFIG_ESPTOOLPY_FLASHSIZE="4MB"
CONFIG_PARTITION_TABLE_CUSTOM=y
CONFIG_PARTITION_TABLE_CUSTOM_FILENAME="partitions.csv"
CONFIG_PARTITION_TABLE_FILENAME="partitions.csv"
```
